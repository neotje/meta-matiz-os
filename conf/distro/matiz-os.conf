## conf/distro/matiz-os.conf
```bitbake
DISTRO_NAME="Matiz os (production)"
DISTRO_VERSION="0.1"

DISTRO_FEATURES="x11"

DISABLE_OVERSCAN = "1"
```

## conf/layer.conf
```bitbake
# We have a conf and classes directory, add to BBPATH
BBPATH .= ":${LAYERDIR}"

# We have recipes-* directories, add to BBFILES
BBFILES += "${LAYERDIR}/recipes-*/*/*.bb \
            ${LAYERDIR}/recipes-*/*/*.bbappend"

BBFILE_COLLECTIONS += "meta-matiz-os"
BBFILE_PATTERN_meta-matiz-os = "^${LAYERDIR}/"
BBFILE_PRIORITY_meta-matiz-os = "6"

LAYERDEPENDS_meta-matiz-os = "core"
LAYERSERIES_COMPAT_meta-matiz-os = "dunfell"
```
